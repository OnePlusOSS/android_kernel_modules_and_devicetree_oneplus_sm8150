## vendor/oplus/kernel/oplus_performance/oplus_multi_kswapd/Kconfig
```kconfig
# SPDX-License-Identifier: GPL-2.0-only
# Copyright (C) 2018-2020 Oplus. All rights reserved.

config OPLUS_MULTI_KSWAPD
       bool "Enable oplus multi kswapd"
       default n
       help
         oplus multi kswapd
```

## vendor/oplus/kernel/oplus_performance/oplus_uxio_first/Kconfig
```kconfig
# SPDX-License-Identifier: GPL-2.0-only
# Copyright (C) 2018-2020 Oplus. All rights reserved.

config OPLUS_FEATURE_UXIO_FIRST
	bool "Support for oplus ux io first opt"
	default y
	help
	  Enable oplus ux io first opt.
```
